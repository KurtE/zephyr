## dts/bindings/video/himax,hm01b0.yaml
```yaml
# Copyright The Zephyr Project Contributors
# SPDX-License-Identifier: Apache-2.0

# example:
# &i2c0
# {
# 	status = "okay";
# 	hm01b0: hm01b0@24{
# 		compatible = "himax,hm01b0";
# 		reg = <0x24>;
# 		status = "okay";
# 		port {
# 					hm01b0_ep_out: endpoint {
# 							remote-endpoint-label = "video_pio_dma_ep_in";
# 					};
# 			};
# 	};
# };


description: Himax HM01B0 video sensor

compatible: "himax,hm01b0"

properties:
  data-bits:
    type: int
    default: 0x1
    description: Camera input data width. 1/4/8 bits
    enum: [1, 4, 8]

  reset-gpios:
    type: phandle-array
    description: |
      The RESETn pin is asserted to disable the sensor causing a hard
      reset. The sensor receives this as an active-low signal.
  pwdn-gpios:
    type: phandle-array
    description: |
      The PWDN pin is asserted to power down the sensor. The sensor
      receives this as an active high signal

include: i2c-device.yaml

child-binding:
  child-binding:
    include: video-interfaces.yaml
```
